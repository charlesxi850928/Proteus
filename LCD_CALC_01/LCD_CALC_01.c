#include <reg51.h>
sbit E = P2^0;
sbit RW = P2^1;
sbit RS = P2^2;
sbit CS1 = P2^3;
sbit CS2 = P2^4;
sbit RST = P2^5;
unsigned char code dispx[]={
0x00,0x00,0x80,0xC0,0x60,0x60,0x60,0x60,0xC0,0x80,0x00,0x00,0x00,0xFE,0xFF,0x01,
0x00,0x00,0x00,0x00,0x01,0xFF,0xFE,0x00,0x00,0x00,0x03,0x07,0x0C,0x0C,0x0C,0x0C,
0x07,0x03,0x00,0x00,/*"0",0*/
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0x00,0x00,0x00,0x00/*"r",24*/


};
void writeCMD(unsigned char x){
	int i;
	RS=0;//CMD
	RW=0;//Write
	P0=x;//CMD Content
	E=1;//Enable/Start Read/Write Data
	for(i=0;i<20;i++);//Wait
	E=0;//Colose/End Read/Write Data
}
void initLCD(){
	writeCMD(0x3F);//Open Display
	writeCMD(0xC0);//Set Initial Row
	writeCMD(0xB8);//Set X Coordinate
	writeCMD(0x40);//Set Y Coordinate
}
void writeData(unsigned char x){
	int i;
	RS=1;//Data
	RW=0;//Write
	P0=x;//Data Content
	E=1;//Enable/Start Read/Write Data
	for(i=0;i<20;i++);//Wait
	E=0;//Close/End Read/Write Data
}
void showOneChar(unsigned char index,position){
	int x,y,k;
	//x<3,12x24,12 cols, 24 rows, every 8 rows will render one time
	for(k=index*36,x=0;x<3;x++){
		if(position<5){
			CS1 = 0;
			CS2 = 1;
			writeCMD(0xBA+x);
			writeCMD(0x44+position*12);
			for(y=0;y<12;y++){
				writeData(dispx[k++]);
			}
		}else{
			CS1 = 1;
			CS2 = 0;
			writeCMD(0xBA+x);
			writeCMD(0x40+(position-5)*12);
			for(y=0;y<12;y++){
				writeData(dispx[k++]);
			}
		}
	}
}
void clearLCD(){
	int x,y,k;
	RST = 0;
	RST = 1;
	initLCD();
	//Only 8 rows data
	for(k=0,x=0;x<8;x++){
		//Left 64 points
		CS1 = 0;
		CS2 = 1;
		writeCMD(0xB8+x);
		for(y=0;y<64;y++){
			writeData(0x00);
		}
		//Right 64 points
		CS1 = 1;
		CS2 = 0;
		writeCMD(0xB8+x);
		for(y=0;y<64;y++){
			writeData(0x00);
		}
	}
}
int readKey(){
	  int keyValue = 0xFF;
	  int debounce = 5000;
		long k,p;	
    //7,4,1,ON/C		
		P1 = 0xEF;
		p = P1;
		if(p!=0xEF){
			//debounce
			k = debounce;
			while(k--);
			p = P1;
			switch(p){
				case 0xEE: keyValue = 7; break;
				case 0xED: keyValue = 4; break;
				case 0xEB: keyValue =  1; break;
				case 0xE7: keyValue =  25; break;
			}
		}
		//8,5,2,0
		P1 = 0xDF;
		p = P1;
		if(p!=0xDF){
			//debounce
			k = debounce;
			while(k--);
			p = P1;
			switch(p){
				case 0xDE: keyValue =  8; break;
				case 0xDD: keyValue =  5; break;
				case 0xDB: keyValue =  2; break;
				case 0xD7: keyValue =  0; break;
			}
		}
		//9,6,3,=
		P1 = 0xBF;
		p = P1;
		if(p!=0xBF){
			//debounce
			k = debounce;
			while(k--);
			p = P1;
			switch(p){
				case 0xBE: keyValue =  9; break;
				case 0xBD: keyValue =  6; break;
				case 0xBB: keyValue =  3; break;
				case 0xB7: keyValue =  10; break;
			}
		}
		//%,X,-,+
		P1 = 0x7F;
		p = P1;
		if(p!=0x7F){
			//debounce
			k = debounce;
			while(k--);
			p = P1;
			switch(p){
				case 0x7E: keyValue =  14; break;
				case 0x7D: keyValue =  13; break;
				case 0x7B: keyValue =  12; break;
				case 0x77: keyValue =  11; break;
			}
		}
		return keyValue;
}
void main(){
	int key;
	int step = 0;
	int num1,op,num2;
	long result;
	RST = 0;
	RST = 1;
	initLCD();
	showOneChar(15,0);
	showOneChar(16,1);
	showOneChar(17,2);
	showOneChar(18,3);
	showOneChar(19,4);
	showOneChar(20,5);
	showOneChar(21,6);
	showOneChar(22,7);
	showOneChar(23,8);
	showOneChar(24,9);
	while(1){
		key=0xFF;
		while(key==0xFF)key = readKey();
		//ON/C
		if(key==25){
			step = 0;
			clearLCD();
			continue;
		}
		step++;
		switch(step){
			case 1: 
						num1 = key; 
						showOneChar(num1,0);
						break;
			case 2: 
						op = key; 
						showOneChar(op,1);
						break;
			case 3: 
						num2 = key; 
						showOneChar(num2,2);
						break;
			case 4:
						if(key==10){
							//+
							if(op==11){
								result = num1+num2;
							//-
							}else if(op==12){
								result = num1 - num2;
							//x
							}else if(op==13){
								result = num1 * num2;
							//%
							}else if(op==14){
								result = num1 / num2;
							}
							//Display "=" 
							showOneChar(10,3);
							//Display value...
							if(result<10)showOneChar(result,4);
							else{
								showOneChar(result/10,4);
								showOneChar(result%10,5);
							}
						}
						break;
			default: break;

		}
	}
	while(1);
}
