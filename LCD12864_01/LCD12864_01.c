#include <reg51.h>
sbit E = P2^0;
sbit RW = P2^1;
sbit RS = P2^2;
sbit CS1 = P2^3;
sbit CS2 = P2^4;
sbit RST = P2^5;
unsigned char code dispx[]={
0x00,0x00,0x00,0x00,0x00,0x00,0x00,0x00,0x00,0x00,0x00,0x00,0x00,0x00,0x00,0x00,
0x00,0x00,0x00,0x00,0x00,0x80,0xC0,0x80,0xC0,0xC0,0xE0,0xE0,0xE0,0xE0,0xF0,0xF0,
0xF0,0xE0,0xC0,0x80,0x00,0x00,0x00,0x00,0x00,0x00,0x00,0x00,0x00,0x00,0x00,0x00,
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0x03,0x0F,0x1E,0x18,0x38,0x30,0x3E,0x3E,0x00,0x00,0x00,0x00,0x00,0x00,0x00,0x00
};
void writeCMD(unsigned char x){
	int i;
	RS=0;//CMD
	RW=0;//Write
	P0=x;//CMD Content
	E=1;//Enable/Start Read/Write Data
	for(i=0;i<20;i++);//Wait
	E=0;//Colose/End Read/Write Data
}
void initLCD(){
	writeCMD(0x3F);//Open Display
	writeCMD(0xC0);//Set Initial Row
	writeCMD(0xB8);//Set X Coordinate
	writeCMD(0x40);//Set Y Coordinate
}
void writeData(unsigned char x){
	int i;
	RS=1;//Data
	RW=0;//Write
	P0=x;//Data Content
	E=1;//Enable/Start Read/Write Data
	for(i=0;i<20;i++);//Wait
	E=0;//Close/End Read/Write Data
}
void main(){
	int x,y,k;
	RST = 0;
	RST = 1;
	initLCD();
	//Only 8 rows data
	for(k=0,x=0;x<8;x++){
		//Left 64 points
		CS1 = 0;
		CS2 = 1;
		writeCMD(0xB8+x);
		for(y=0;y<64;y++){
			writeData(dispx[k++]);
		}
		//Right 64 points
		CS1 = 1;
		CS2 = 0;
		writeCMD(0xB8+x);
		for(y=0;y<64;y++){
			writeData(dispx[k++]);
		}
	}
	while(1);
}
